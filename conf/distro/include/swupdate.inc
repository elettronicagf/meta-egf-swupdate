## conf/distro/include/swupdate.inc
```bitbake
SWU_BOARDNAME ?= "${MACHINE}"
SWU_BOARDREV ?= "revA"

SWU_TMPDIR ?= "/mnt/ota"

INHERIT += "image-ext4-swu"
```

## recipes-support/swupdate/swupdate/defconfig
```kconfig
#
# SWUpdate Settings
#

#
# General Configuration
#
CONFIG_SYSTEMD=y
CONFIG_DEFAULT_CONFIG_FILE="/etc/swupdate.cfg"
CONFIG_SCRIPTS=y
CONFIG_HW_COMPATIBILITY=y
CONFIG_SW_VERSIONS_FILE="/etc/sw-versions"

#
# Socket Paths
#
CONFIG_SOCKET_CTRL_PATH=""
CONFIG_SOCKET_PROGRESS_PATH=""
# end of Socket Paths

# CONFIG_MTD is not set
# CONFIG_LUA is not set
# end of General Configuration

#
# Build Options
#
CONFIG_CROSS_COMPILE=""
CONFIG_SYSROOT=""
CONFIG_EXTRA_CFLAGS=""
CONFIG_EXTRA_LDFLAGS=""
CONFIG_EXTRA_LDLIBS=""
# end of Build Options

#
# Debugging Options
#
# CONFIG_DEBUG is not set
# CONFIG_WERROR is not set
# CONFIG_NOCLEANUP is not set
# end of Debugging Options
# end of SWUpdate Settings

#
# Bootloader support
#

#
# Bootloader Interfaces
#
# CONFIG_BOOTLOADER_NONE is not set
# CONFIG_BOOTLOADER_EBG is not set
CONFIG_UBOOT=y
CONFIG_UBOOT_FWENV="/etc/fw_env.config"
CONFIG_UBOOT_DEFAULTENV="/etc/u-boot-imx-egf-initial-env"
# CONFIG_BOOTLOADER_GRUB is not set
# CONFIG_BOOTLOADER_CBOOT is not set
# end of Bootloader Interfaces

CONFIG_BOOTLOADER_DEFAULT_UBOOT=y
# CONFIG_BOOTLOADER_STATIC_LINKED is not set
CONFIG_UPDATE_STATE_CHOICE_BOOTLOADER=y
CONFIG_UPDATE_STATE_BOOTLOADER="ustate"

#
# Interfaces
#
# CONFIG_DOWNLOAD is not set
# CONFIG_SURICATTA is not set
# CONFIG_WEBSERVER is not set

#
# Security
#

#
# Crypto libraries
#
CONFIG_SSL_IMPL_OPENSSL=y
# CONFIG_SSL_IMPL_WOLFSSL is not set
# CONFIG_SSL_IMPL_MBEDTLS is not set
# CONFIG_SSL_IMPL_GPGME is not set
# end of Crypto libraries

# CONFIG_HASH_VERIFY is not set
# CONFIG_SIGNED_IMAGES is not set

#
# Encryption
#
# CONFIG_ENCRYPTED_IMAGES is not set
# end of Encryption

#
# Compressors (zlib always on)
#
CONFIG_GUNZIP=y
CONFIG_XZ=y
CONFIG_ZSTD=y

#
# Parsers
#

#
# Parser Features
#
CONFIG_LIBCONFIG=y
CONFIG_PARSERROOT=""
# CONFIG_SETSWDESCRIPTION is not set
# end of Parser Features

#
# Handlers
#

#
# Image Handlers
#
CONFIG_ARCHIVE=y
CONFIG_LOCALE=y
CONFIG_BOOTLOADERHANDLER=y
# CONFIG_COPY is not set
# CONFIG_DELTA is not set
# CONFIG_DISKPART is not set
# CONFIG_DISKFORMAT_HANDLER is not set
# CONFIG_EMMC_HANDLER is not set
CONFIG_RAW=y
# CONFIG_RDIFFHANDLER is not set
# CONFIG_REMOTE_HANDLER is not set
CONFIG_SHELLSCRIPTHANDLER=y
# CONFIG_SWUFORWARDER_HANDLER is not set
# CONFIG_UCFWHANDLER is not set
# CONFIG_UNIQUEUUID is not set
# end of Image Handlers

#
# Containers
#

#
# Update containers
#
# CONFIG_DOCKER is not set
# end of Update containers
```
